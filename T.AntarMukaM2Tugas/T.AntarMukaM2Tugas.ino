#include <Wire.h>
#include <Adafruit_GFX.h>
#include <Adafruit_SSD1306.h>
#define OLED_RESET 4
Adafruit_SSD1306 display(128, 64, &Wire, OLED_RESET);
const unsigned char Wajahku [] PROGMEM = {
  0xff, 0xff, 0xff, 0xff, 0xff, 0xff, 0xe0, 0xff, 0xff, 0xff, 0xff, 0xff, 0xff, 0xe0, 0xff, 0xff,
  0xff, 0xff, 0xff, 0xff, 0xe0, 0xff, 0xff, 0xff, 0xff, 0xff, 0xff, 0xe0, 0xff, 0xff, 0xff, 0xff,
  0xff, 0xff, 0xe0, 0xff, 0xff, 0xff, 0xff, 0xff, 0xff, 0xe0, 0xff, 0xff, 0xff, 0xff, 0xff, 0xff,
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  0xff, 0xe0, 0xff, 0xff, 0xff, 0xff, 0xff, 0xff, 0xe0, 0xff, 0xff, 0xff, 0xff, 0xff, 0xdf, 0xe0
};
const unsigned char Normal [] PROGMEM = {
  0xff, 0xff, 0xff, 0xff, 0xff, 0xff, 0xff, 0xe0, 0xff, 0xff, 0xff, 0xff, 0xff, 0xff, 0xff, 0xff,
  0xff, 0xff, 0xff, 0xff, 0xff, 0xff, 0xff, 0xe0, 0xff, 0xff, 0xff, 0xff, 0xff, 0xff, 0xff, 0xff,
  0xff, 0xff, 0xff, 0xff, 0xff, 0xff, 0xff, 0x00, 0x3f, 0xff, 0xff, 0xff, 0xff, 0xff, 0xff, 0xff,
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  0xff, 0xff, 0xff, 0xff, 0xff, 0xff, 0xfc, 0x1f, 0x07, 0xff, 0xff, 0xff, 0xff, 0xff, 0xff, 0xff
};
const unsigned char A21 [] PROGMEM = {
  0xff, 0xff, 0xff, 0xff, 0x80, 0x00, 0x01, 0xff, 0xff, 0xff, 0xff, 0xe0, 0xff, 0xff, 0xff, 0xff,
  0xff, 0x00, 0xff, 0xff, 0xff, 0xff, 0xff, 0xe0, 0xff, 0xff, 0xff, 0xff, 0xff, 0x00, 0xff, 0xff,
  0xff, 0xff, 0xff, 0xe0, 0xff, 0xff, 0xff, 0xff, 0xf0, 0x00, 0x0f, 0xff, 0xff, 0xff, 0xff, 0xe0,
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  0xff, 0xff, 0xff, 0xe0, 0xff, 0xff, 0xff, 0xff, 0x00, 0xfe, 0x01, 0xff, 0xff, 0xff, 0xff, 0xe0
};
const unsigned char A41 [] PROGMEM = {
  0xff, 0xff, 0xff, 0xff, 0xfe, 0x00, 0xff, 0xff, 0xff, 0xff, 0xff, 0xf0, 0xff, 0xff, 0xff, 0xff,
  0xff, 0x00, 0xff, 0xff, 0xff, 0xff, 0xff, 0xf0, 0xff, 0xff, 0xff, 0xff, 0xff, 0x00, 0xff, 0xff,
  0xff, 0xff, 0xff, 0xf0, 0xff, 0xff, 0xff, 0xff, 0xf0, 0x00, 0x1f, 0xff, 0xff, 0xff, 0xff, 0xf0,
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  0xff, 0xff, 0xff, 0xf0, 0xff, 0xff, 0xff, 0xff, 0x00, 0xfe, 0x01, 0xff, 0xff, 0xff, 0xff, 0xf0
};
const unsigned char A61 [] PROGMEM = {
  0xff, 0xff, 0xff, 0xff, 0xff, 0x00, 0xff, 0xff, 0xff, 0xff, 0xff, 0xf0, 0xff, 0xff, 0xff, 0xff,
  0xff, 0x00, 0xff, 0xff, 0xff, 0xff, 0xff, 0xf0, 0xff, 0xff, 0xff, 0xff, 0xff, 0x00, 0xff, 0xff,
  0xff, 0xff, 0xff, 0xf0, 0xff, 0xff, 0xfc, 0x03, 0xf0, 0x00, 0x0f, 0xe0, 0x0f, 0xff, 0xff, 0xf0,
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  0xff, 0xff, 0xff, 0xf0, 0xff, 0xff, 0xff, 0xff, 0x80, 0xff, 0x00, 0xff, 0xff, 0xff, 0xff, 0xf0
};
const unsigned char A81 [] PROGMEM = {
  0xff, 0xff, 0xff, 0xff, 0xff, 0x00, 0xff, 0xff, 0xff, 0xff, 0xff, 0xe0, 0xff, 0xff, 0xff, 0xff,
  0xff, 0x00, 0xff, 0xff, 0xff, 0xff, 0xff, 0xe0, 0xff, 0xff, 0xff, 0xff, 0xff, 0x00, 0xff, 0xff,
  0xff, 0xff, 0xff, 0xe0, 0xff, 0xff, 0xfc, 0x03, 0xf0, 0x00, 0x1f, 0xe0, 0x1f, 0xff, 0xff, 0xe0,
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  0xff, 0xff, 0xff, 0xe0, 0xff, 0xff, 0xff, 0xff, 0xff, 0xff, 0xff, 0xff, 0xff, 0xff, 0xff, 0xe0
};
//Syarif Hidayat D400220086
const unsigned char* Animasi[9] = {Normal, A21, A41, A61, A81, A61, A41, A21};
unsigned long time = 0;
const int T1 = 2;
const int T2 = 3;
void setT() {
  pinMode(T1, INPUT_PULLUP);
  pinMode(T2, INPUT_PULLUP);
}
void setup() {// Syarif Hidayat _ D400220086
  display.begin(SSD1306_SWITCHCAPVCC, 0x3C);
  display.clearDisplay();
  setT();
}// Syarif Hidayat _ D400220086
void loop() {
  if (digitalRead(T1) == 0 && digitalRead(T2) == 1) {
    Kondisi_1();
  }
  else if (digitalRead(T1) == 1 && digitalRead(T2) == 0) {
    while (1) {
      renang(100);
      if (digitalRead(T1) == 0 && digitalRead(T2) == 1) {
        break;
      }
    }
  }
  else {
    display.display();
  }
}//Syarif Hidayat D400220086
void Kondisi_1() {
  display.clearDisplay();
  display.drawBitmap(35, 0, Wajahku, 51, 64, WHITE);
  display.display();
}
void renang(int dellay) {
  for (int i = 0; i < 8; i++) {
    display.drawBitmap(22, 0, Animasi[i], 91, 64, WHITE);
    display.display();
    if (digitalRead(T1) == 0 && digitalRead(T2) == 1) {
      break;
    }
    time = millis();
    while (1) {
      if (digitalRead(T1) == 0 && digitalRead(T2) == 1) {
        break;
      }//Syarif Hidayat D400220086
      if (millis - time >= dellay) {
        display.clearDisplay();
        break;
      }
    }
  }
}
